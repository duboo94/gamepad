## boards/shields/sirius19/Kconfig.defconfig
```kconfig
if SHIELD_SIRIUS19_DONGLE

config ZMK_KEYBOARD_NAME
    default "SIRIUS19 gamepad"

config ZMK_SPLIT_ROLE_CENTRAL
    default y

endif

if SHIELD_SIRIUS19_DONGLE || SHIELD_SIRIUS19_LEFT || SHIELD_SIRIUS19_RIGHT

config ZMK_SPLIT
    default y

endif
```

## boards/shields/sirius19/Kconfig.shield
```kconfig
config SHIELD_SIRIUS19_DONGLE
    def_bool $(shields_list_contains,sirius19_dongle)

config SHIELD_SIRIUS19_LEFT
    def_bool $(shields_list_contains,sirius19_left)

config SHIELD_SIRIUS19_RIGHT
    def_bool $(shields_list_contains,sirius19_right)
```

## config/west.yml
```yaml
manifest:
  remotes:
    - name: zmkfirmware
      url-base: https://github.com/zmkfirmware
    - name: badjeff
      url-base: https://github.com/badjeff
    - name: zettaface
      url-base: https://github.com/zettaface
  projects:
    - name: zmk
      remote: zmkfirmware
      revision: main
      import: app/west.yml
    - name: zmk-pmw3610-driver
      remote: badjeff
      revision: main
    - name: zmk-analog-input-driver
      remote: badjeff
      revision: main
    - name: zmk-input-processor-keybind
      remote: zettaface
      revision: main
  self:
    path: config
```
